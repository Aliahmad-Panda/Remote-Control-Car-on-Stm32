## CMakeLists.txt
```
# SPDX-License-Identifier: Apache-2.0

cmake_minimum_required(VERSION 3.20.0)
find_package(Zephyr REQUIRED HINTS $ENV{ZEPHYR_BASE})
project(Remote-Control-Car-on-Stm32)

FILE(GLOB app_sources src/*.c)
target_sources(app PRIVATE ${app_sources})
```

## sample.yaml
```
sample:
  name: practice Sample
tests:
  sample.basic.practice:
    tags:
      - LED
      - gpio
      - devicetree
    filter: dt_enabled_alias_with_parent_compat("led0", "gpio-leds")
    depends_on: gpio
    harness: led
    integration_platforms:
      - frdm_k64f
```

## prj.conf
```kconfig
# Enable necessary drivers
CONFIG_GPIO=y
CONFIG_SPI=y
CONFIG_DISPLAY=y
CONFIG_CONSOLE=y
CONFIG_PRINTK=y

CONFIG_SERIAL=y
CONFIG_UART_CONSOLE=y


# Enable the ILI9341 display driver
CONFIG_ILI9341=y

# Enable logging (optional)
CONFIG_LOG=y
CONFIG_LOG_DEFAULT_LEVEL=3

# Enable threading support
CONFIG_THREAD_MONITOR=y

CONFIG_ADC=y

# CONFIG_PWM=y
# CONFIG_PWM_STM32=y
```

## boards/stm32f429i_disc1.overlay
```dts
/*
 * Copyright (c) 2023 Martin Jäger / Libre Solar
 *
 * SPDX-License-Identifier: Apache-2.0
 */

/ {
	load_switch: load_switch {
		compatible = "power-switch";
		/* using built-in LED pin for demonstration */
		gpios = <&gpioa 5 GPIO_ACTIVE_HIGH>;
	}; 
};
/ {
	another_switch: another_switch {
		compatible = "power-switch";
		/* using built-in LED pin for demonstration */
		gpios = <&gpioa 4 GPIO_ACTIVE_HIGH>;
	}; 
};
```

## src/main.c
```c
/*
 * Copyright (c) 2023 Libre Solar Technologies GmbH
 *
 * SPDX-License-Identifier: Apache-2.0
 */

#include <stdio.h>
#include <stdlib.h>
#include <time.h>
#include <string.h>
#include <zephyr/device.h>
#include <zephyr/sys/printk.h>
#include <zephyr/sys/util.h>
#include <inttypes.h>
#include <zephyr/devicetree.h>
#include <zephyr/drivers/gpio.h>
#include <zephyr/kernel.h>


//For the thread
#define STACK_SIZE 1024
#define THREAD_PRIORITY 5

#if !DT_NODE_EXISTS(DT_NODELABEL(load_switch))
#error "Overlay for power output node not properly defined."
#endif
#if !DT_NODE_EXISTS(DT_NODELABEL(another_switch))
#error "Overlay for power output node not properly defined."
#endif

//Thread structure and stack definition.
K_THREAD_STACK_DEFINE(thread_stack, STACK_SIZE);
struct k_thread thread_data;


static const struct gpio_dt_spec load_switch =
	GPIO_DT_SPEC_GET_OR(DT_NODELABEL(load_switch), gpios, {0});

static const struct gpio_dt_spec another_switch =
	GPIO_DT_SPEC_GET_OR(DT_NODELABEL(another_switch), gpios, {0});




//Thread Function.
void thread_function(void *unused1, void *unused2, void *unused3)
{
    while (1)
    {
        gpio_pin_set_dt(&load_switch, 1);
        printf("Switching on(from thread)\n");
        k_sleep(K_MSEC(1000));
        gpio_pin_set_dt(&load_switch, 0);
        printf("Switching off(from thread)\n");
        k_sleep(K_MSEC(1000));
    }
}


int main(void)
{
	int err;

	if (!gpio_is_ready_dt(&load_switch)) {
		printf("The load switch pin GPIO port is not ready.\n");
		return 0;
	}
	if (!gpio_is_ready_dt(&another_switch)) {
		printf("The load switch pin GPIO port is not ready.\n");
		return 0;
	}
	printf("Initializing pin with inactive level.\n");
	err = gpio_pin_configure_dt(&load_switch, GPIO_OUTPUT_INACTIVE);
	if (err != 0) {
		printf("Configuring GPIO pin failed: %d\n", err);
		return 0;
	}
	err = gpio_pin_configure_dt(&another_switch, GPIO_OUTPUT_INACTIVE);
	if (err != 0) {
		printf("Configuring GPIO pin failed: %d\n", err);
		return 0;
	}

    k_tid_t my_tid = k_thread_create(&thread_data, thread_stack, STACK_SIZE, thread_function, NULL, NULL, NULL, THREAD_PRIORITY, 0, K_NO_WAIT);
    k_thread_name_set(my_tid, "thread_function");

	printf("Waiting one second.\n");

	k_sleep(K_MSEC(1000));

	printf("Setting pin to active level.\n");

	err = gpio_pin_set_dt(&load_switch, 1);
	if (err != 0) {
		printf("Setting GPIO pin level failed: %d\n", err);
	}
	while (1)
	{
		gpio_pin_set_dt(&another_switch, 1);
		printk("Switching on\n");
        // printf("Switching on(printf)\n");
        k_sleep(K_MSEC(1000));
		gpio_pin_set_dt(&another_switch, 0);
        printk("Switching off\n");
        // printf("Switching off(printf)\n");
		k_sleep(K_MSEC(1000));
	}
	
	return 0;
}
```
